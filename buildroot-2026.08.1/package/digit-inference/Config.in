## buildroot-2026.08.1/package/digit-inference/Config.in
```kconfig
config BR2_PACKAGE_DIGIT_INFERENCE
    bool "digit-inference"
    help
      Lightweight handwritten digit recognition application
      using a Logistic Regression model.
```
